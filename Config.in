## Config.in
```kconfig
# SPDX-License-Identifier: GPL-2.0-only
#
# Copyright (C) 2006-2013 OpenWrt.org

mainmenu "OpenWrt Configuration"

config MODULES
	modules
	bool
	default y

config HAVE_DOT_CONFIG
	bool
	default y

HOST_OS := $(shell, uname)

config HOST_OS_LINUX
	def_bool $(shell, ./config/check-uname.sh Linux)

config HOST_OS_MACOS
	def_bool $(shell, ./config/check-uname.sh Darwin)

source "target/Config.in"

source "config/Config-images.in"

source "config/Config-build.in"

source "config/Config-devel.in"

source "toolchain/Config.in"

source "target/imagebuilder/Config.in"

source "target/sdk/Config.in"

source "target/toolchain/Config.in"

source "tmp/.config-package.in"

config OPENMANET_MM8108_TRIAL
	bool "Isolated MM8108 USB 2.2 trial (RPi4 only)"
	depends on TARGET_bcm27xx_bcm2711
	default n
	help
	  Select the experimental driver dependency for existing Morse userspace.
	  Use only the rpi4-mm8108-2.2-trial board in a separate build tree.

config OPENMANET_MM6108_TRIAL
	bool "Isolated MM6108 SPI 2.2 trial (RPi4 only)"
	depends on TARGET_bcm27xx_bcm2711 && !OPENMANET_MM8108_TRIAL
	default n
	help
	  Use only the rpi4-mm6108-2.2-trial board configuration.

config OPENMANET_MORSE_22_TRIAL
	bool
	default y if OPENMANET_MM8108_TRIAL || OPENMANET_MM6108_TRIAL
```
